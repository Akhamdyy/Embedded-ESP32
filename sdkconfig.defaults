## sdkconfig.defaults
```kconfig
# Bluetooth Classic SPP via Bluedroid — no BLE, no Arduino
CONFIG_BT_ENABLED=y
CONFIG_BT_CONTROLLER_ENABLED=y
CONFIG_BTDM_CTRL_MODE_BR_EDR_ONLY=y
CONFIG_BT_BLUEDROID_ENABLED=y
CONFIG_BT_CLASSIC_ENABLED=y
CONFIG_BT_SPP_ENABLED=y
CONFIG_BT_BLE_ENABLED=n

# Disable brownout reset — motor current spikes briefly sag the 3.3V rail
# below 2.43V (the lowest threshold).  Without this the chip resets mid-run
# and BT drops.  A 1000 µF bulk cap across the ESP32 5V input is the proper
# hardware fix, but disabling the reset lets the chip ride through the dip.
CONFIG_ESP_BROWNOUT_DET=n
CONFIG_ESP32_BROWNOUT_DET=n
```
